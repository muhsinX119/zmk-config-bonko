#include <dt-bindings/zmk/matrix_transform.h>
#include <dt-bindings/pinctrl/nrf-pinctrl.h>
#include <dt-bindings/led/led.h>

&pinctrl {
    p0_15_disabled: p0_15_disabled {
        group1 {
            psels = <NRF_PSEL(GPIO, 0, 15)>;
            bias-disable;
        };
    };
};
